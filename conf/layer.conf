## conf/layer.conf
```bitbake
# modified from https://github.com/resin-os/resin-raspberrypi/blob/master/layers/meta-resin-raspberrypi/conf/layer.conf
BBPATH .= ":${LAYERDIR}"

BBFILES += "${LAYERDIR}/recipes-*/*/*.bb \
            ${LAYERDIR}/recipes-*/*/*.bbappend"

BBFILE_COLLECTIONS += "resin-freescale"
BBFILE_PATTERN_resin-freescale := "^${LAYERDIR}/"
BBFILE_PRIORITY_resin-freescale = "1337"

# leave out KERNEL_DEVICETREE_append overlays

# We use udev rules to create serial device aliases
SERIAL_CONSOLE = "115200 serial0"
```
